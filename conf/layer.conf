## conf/layer.conf
```bitbake
# We have a conf and classes directory, add to BBPATH
BBPATH .= ":${LAYERDIR}"

# We have recipes-* directories, add to BBFILES
BBFILES += "${LAYERDIR}/recipes-*/*/*.bb \
            ${LAYERDIR}/recipes-*/*/*.bbappend"

BBFILE_COLLECTIONS += "meta-watchdog-spam"
BBFILE_PATTERN_meta-watchdog-spam = "^${LAYERDIR}/"
BBFILE_PRIORITY_meta-watchdog-spam = "6"

LAYERDEPENDS_meta-watchdog-spam = "core"
LAYERSERIES_COMPAT_meta-watchdog-spam = "styhead walnascar"
```
